## CMakeLists.txt
```
cmake_minimum_required(VERSION 3.22)

set(BOARD pinetime_devkit0)

find_package(Zephyr REQUIRED HINTS $ENV{ZEPHYR_BASE})

project(zephyrtime LANGUAGES CXX VERSION 0.0.1)

target_sources(app PRIVATE ./src/main.cpp)
```

## west.yml
```
manifest:
  self:
    path: zephyrtime

  group-filter: [-tee, -segger]

  remotes:
    - name: zephyrproject-rtos
      url-base: https://github.com/zephyrproject-rtos

  projects:
    - name: zephyr
      remote: zephyrproject-rtos
      revision: v3.1.0
      import: true
```

## prj.conf
```kconfig
CONFIG_GPIO=y

CONFIG_DISPLAY=y
CONFIG_DISPLAY_LOG_LEVEL_ERR=y

CONFIG_LVGL=y
CONFIG_LV_MEM_CUSTOM=y
CONFIG_LV_USE_LOG=y
CONFIG_LV_USE_LABEL=y
CONFIG_LV_USE_BTN=y
CONFIG_LV_USE_IMG=y
CONFIG_LV_FONT_MONTSERRAT_14=y
```

## src/main.cpp
```c
#include <sys/printk.h>
#include <zephyr.h>

/* 1000 msec = 1 sec */
#define SLEEP_TIME_MS 1000

void main(void) {
  while (1) {
    printk("Hello world! %s\n", CONFIG_BOARD);
    k_msleep(SLEEP_TIME_MS);
  }
}
```
